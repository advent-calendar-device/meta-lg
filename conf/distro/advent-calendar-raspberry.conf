## conf/distro/advent-calendar-raspberry.conf
```bitbake
require conf/distro/poky.conf

DISTRO = "advent-calendar-raspberry"

POKY_INIT_MANAGER = "systemd"

DISTRO_FEATURES:append = " directfb"
DISTRO_FEATURES:remove = "x11 wayland pam"

DISTRO_FEATURES:append = " opengl egl gbm drm"

#DISTRO_FEATURES:remove = "vulkan"

ENABLE_SPI_BUS = "1"
ENABLE_UART = "1"
RPI_EXTRA_CONFIG:append = " dtparam=audio=on"
```

## conf/distro/advent-calendar.conf
```bitbake
include conf/distro/fsl-imx-fb.conf

DISTRO = "advent-calendar"

# Remove conflicting backends
DISTRO_FEATURES:append = " directfb"
DISTRO_FEATURES:remove = "x11 wayland pam"

DISTRO_FEATURES:append = " opengl egl gbm drm"


#PACKAGECONFIG:append:pn-weston      = " rdp"
#PACKAGECONFIG:append:pn-weston-init = " rdp"
```

## conf/layer.conf
```bitbake
# We have a conf and classes directory, add to BBPATH
BBPATH .= ":${LAYERDIR}"

# We have recipes-* directories, add to BBFILES
BBFILES += "${LAYERDIR}/recipes-*/*/*.bb \
            ${LAYERDIR}/recipes-*/*/*.bbappend"

BBFILE_COLLECTIONS += "meta-lg"
BBFILE_PATTERN_meta-lg = "^${LAYERDIR}/"
BBFILE_PRIORITY_meta-lg = "6"

LAYERDEPENDS_meta-lg = "core"
LAYERSERIES_COMPAT_meta-lg = "scarthgap"
```
